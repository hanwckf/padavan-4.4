## trunk/linux-4.4.x/Documentation/devicetree/bindings/display/panel/truly,bd0598u4004.txt
```
MIPI DSI Video Mode Panel

Required properties:
  - compatible: "truly,bd0598u4004"
  - reg: the virtual channel number of a DSI peripheral
  - reset-gpios: panel reset gpio

Optional properties:
  - video port for DSI input

Example:

	panel@0 {
		compatible = "truly,bd0598u4004";
		pinctrl-names = "default";
		pinctrl-0 = <&panel_reset_pin>;
		reset-gpios = <&pio 83 0>;
		reg = <0>;

		port {
			panel_in: endpoint {
				remote-endpoint = <&dsi_out>;
			};
		};
	};
```

## trunk/linux-4.4.x/Documentation/devicetree/bindings/i2c/i2c-mt6577.txt
```
* Mediatek's I2C controller

The Mediatek's I2C controller is used to interface with I2C devices.

Required properties:
  - compatible: value should be either of the following.
	"mediatek,mt2701-i2c", for i2c compatible with mt2701 i2c.
	"mediatek,mt2712-i2c", for i2c compatible with mt2712 i2c.
	"mediatek,mt6577-i2c", for i2c compatible with mt6577 i2c.
	"mediatek,mt6589-i2c", for i2c compatible with mt6589 i2c.
	"mediatek,mt8127-i2c", for i2c compatible with mt8127 i2c.
	"mediatek,mt8135-i2c", for i2c compatible with mt8135 i2c.
	"mediatek,mt8173-i2c", for i2c compatible with mt8173 i2c.
  - reg: physical base address of the controller and dma base, length of memory
    mapped region.
  - interrupts: interrupt number to the cpu.
  - clocks: clock name from clock manager
  - clock-names: Must include "main" and "dma", if enable have-pmic need include
    "pmic" extra. "top-source","top-sel","main-source" and "main-sel" are also
    required for mt2712.

Optional properties:
  - clock-div: the fixed value for frequency divider of clock source in i2c
    module. Each IC may be different. mt2712 doesn't need this property.
  - clock-frequency: Frequency in Hz of the bus when transfer, the default value
    is 100000.
  - mediatek,have-pmic: platform can control i2c form special pmic side.
    Only mt6589 and mt8135 support this feature.
  - mediatek,use-push-pull: IO config use push-pull mode.

Example:

	i2c0: i2c@1100d000 {
			compatible = "mediatek,mt6577-i2c";
			reg = <0x1100d000 0x70>,
			      <0x11000300 0x80>;
			interrupts = <GIC_SPI 44 IRQ_TYPE_LEVEL_LOW>;
			clock-frequency = <400000>;
			mediatek,have-pmic;
			clock-div = <16>;
			clocks = <&i2c0_ck>, <&ap_dma_ck>;
			clock-names = "main", "dma";
	};
```

## trunk/linux-4.4.x/Documentation/devicetree/bindings/misc/richtek,usb_type_c.txt
```
Richtek Typec solution

Required properties:
- compatible: Should be "mediatek,usb_type_c"
- reg: Based on mt6932 PMIC

Examples:

	typec: typec {
		compatible = "mediatek,usb_type_c";
	};
```

## trunk/linux-4.4.x/Documentation/devicetree/bindings/mtd/nand.txt
```
* MTD generic binding

- nand-ecc-mode : String, operation mode of the NAND ecc mode.
  Supported values are: "none", "soft", "hw", "hw_syndrome", "hw_oob_first",
  "soft_bch".
- nand-bus-width : 8 or 16 bus width if not present 8
- nand-on-flash-bbt: boolean to enable on flash bbt option if not present false

- nand-ecc-strength: integer representing the number of bits to correct
		     per ECC step.

- nand-ecc-step-size: integer representing the number of data bytes
		      that are covered by a single ECC step.

- linux,part-probe: list of name as strings of the partition parser
		    which should be used to parse the partition table.
		    They will be tried in the specified ordering and
		    the next one will be used if the previous one
		    failed.

		    Example: linux,part-probe = "cmdlinepart", "ofpart";

		    This is also the default value, which will be used
		    if this attribute is not specified. It could be
		    that the flash driver in use overwrote the default
		    value and uses some other default.

		    Possible values are: bcm47xxpart, afs, ar7part,
		    ofoldpart, ofpart, bcm63xxpart, RedBoot, cmdlinepart

The ECC strength and ECC step size properties define the correction capability
of a controller. Together, they say a controller can correct "{strength} bit
errors per {size} bytes".

The interpretation of these parameters is implementation-defined, so not all
implementations must support all possible combinations. However, implementations
are encouraged to further specify the value(s) they support.
```

## trunk/linux-4.4.x/Documentation/devicetree/bindings/pinctrl/pinctrl-leopard.txt
```
== MediaTek leopard pinctrl controller ==

Required properties for the root node:
 - compatible: Should be one of the following
	       "mediatek,leopard-pinctrl" for leopard SoC
 - reg: offset and length of the pinctrl space

 - gpio-controller: Marks the device node as a GPIO controller.
 - #gpio-cells: Should be two. The first cell is the pin number and the
   second is the GPIO flags.

Please refer to pinctrl-bindings.txt in this directory for details of the
common pinctrl bindings used by client devices, including the meaning of the
phrase "pin configuration node".

leopard pin configuration nodes act as a container for an arbitrary number of
subnodes. Each of these subnodes represents some desired configuration for a
pin, a group, or a list of pins or groups. This configuration can include the
mux function to select on those pin(s)/group(s), and various pin configuration
parameters, such as pull-up, slew rate, etc.

We support 2 types of configuration nodes. Those nodes can be either pinmux
nodes or pinconf nodes. Each configuration node can consist of multiple nodes
describing the pinmux and pinconf options.

The name of each subnode doesn't matter as long as it is unique; all subnodes
should be enumerated and processed purely based on their content.

== pinmux nodes content ==

The following generic properties as defined in pinctrl-bindings.txt are valid
to specify in a pinmux subnode:

Required properties are:
 - groups: An array of strings. Each string contains the name of a group.
  Valid values for these names are listed below.
 - function: A string containing the name of the function to mux to the
  group. Valid values for function names are listed below.

== pinconf nodes content ==

The following generic properties as defined in pinctrl-bindings.txt are valid
to specify in a pinconf subnode:

Required properties are:
 - pins: An array of strings. Each string contains the name of a pin.
  Valid values for these names are listed below.
 - groups: An array of strings. Each string contains the name of a group.
  Valid values for these names are listed below.

Optional properies are:
 bias-disable, bias-pull, bias-pull-down, input-enable,
 input-schmitt-enable, input-schmitt-disable, output-enable
 output-low, output-high, drive-strength, slew-rate

 Valid arguments for 'slew-rate' are '0' for no slew rate controlled and '1' for
 slower slew rate respectively.
 Valid arguments for 'drive-strength', 4, 8, 12, or 16 in mA.

The following specific properties as defined are valid to specify in a pinconf
subnode:

Optional properties are:
 - mediatek,tdsel: An integer describing the steps for output level shifter duty
   cycle when asserted (high pulse width adjustment). Valid arguments are from 0
   to 15.
 - mediatek,rdsel: An integer describing the steps for input level shifter duty
   cycle when asserted (high pulse width adjustment). Valid arguments are from 0
   to 63.

== Valid values for pins, function and groups on leopard ==

Valid values for pins are:
pins can be referenced via the pin names as the below table shown and the
related physical number is also put ahead of those names which helps cross
references to pins between groups to know whether pins assignment conflict
happens among devices try to acquire those available pins.

	Pin #:  Valid values for pins
	-----------------------------
	PIN 0: "TOP_5G_CLK"
	PIN 1: "TOP_5G_DATA"
	PIN 2: "WF0_5G_HB0"
	PIN 3: "WF0_5G_HB1"
	PIN 4: "WF0_5G_HB2"
	PIN 5: "WF0_5G_HB3"
	PIN 6: "WF0_5G_HB4"
	PIN 7: "WF0_5G_HB5"
	PIN 8: "WF0_5G_HB6"
	PIN 9: "XO_REQ"
	PIN 10: "TOP_RST_N"
	PIN 11: "SYS_WATCHDOG"
	PIN 12: "EPHY_LED0_N_JTDO"
	PIN 13: "EPHY_LED1_N_JTDI"
	PIN 14: "EPHY_LED2_N_JTMS"
	PIN 15: "EPHY_LED3_N_JTCLK"
	PIN 16: "EPHY_LED4_N_JTRST_N"
	PIN 17: "WF2G_LED_N"
	PIN 18: "WF5G_LED_N"
	PIN 19: "I2C_SDA"
	PIN 20: "I2C_SCL"
	PIN 21: "GPIO_9"
	PIN 22: "GPIO_10"
	PIN 23: "GPIO_11"
	PIN 24: "GPIO_12"
	PIN 25: "UART1_TXD"
	PIN 26: "UART1_RXD"
	PIN 27: "UART1_CTS"
	PIN 28: "UART1_RTS"
	PIN 29: "UART2_TXD"
	PIN 30: "UART2_RXD"
	PIN 31: "UART2_CTS"
	PIN 32: "UART2_RTS"
	PIN 33: "MDI_TP_P1"
	PIN 34: "MDI_TN_P1"
	PIN 35: "MDI_RP_P1"
	PIN 36: "MDI_RN_P1"
	PIN 37: "MDI_RP_P2"
	PIN 38: "MDI_RN_P2"
	PIN 39: "MDI_TP_P2"
	PIN 40: "MDI_TN_P2"
	PIN 41: "MDI_TP_P3"
	PIN 42: "MDI_TN_P3"
	PIN 43: "MDI_RP_P3"
	PIN 44: "MDI_RN_P3"
	PIN 45: "MDI_RP_P4"
	PIN 46: "MDI_RN_P4"
	PIN 47: "MDI_TP_P4"
	PIN 48: "MDI_TN_P4"
	PIN 49: "SMI_MDC"
	PIN 50: "SMI_MDIO"
	PIN 51: "PCIE_PERESET_N"
	PIN 52: "PWM_0"
	PIN 53: "GPIO_0"
	PIN 54: "GPIO_1"
	PIN 55: "GPIO_2"
	PIN 56: "GPIO_3"
	PIN 57: "GPIO_4"
	PIN 58: "GPIO_5"
	PIN 59: "GPIO_6"
	PIN 60: "GPIO_7"
	PIN 61: "GPIO_8"
	PIN 62: "SPI_CLK"
	PIN 63: "SPI_CS"
	PIN 64: "SPI_MOSI"
	PIN 65: "SPI_MISO"
	PIN 66: "SPI_WP"
	PIN 67: "SPI_HOLD"
	PIN 68: "UART0_TXD"
	PIN 69: "UART0_RXD"
	PIN 70: "TOP_2G_CLK"
	PIN 71: "TOP_2G_DATA"
	PIN 72: "WF0_2G_HB0"
	PIN 73: "WF0_2G_HB1"
	PIN 74: "WF0_2G_HB2"
	PIN 75: "WF0_2G_HB3"
	PIN 76: "WF0_2G_HB4"
	PIN 77: "WF0_2G_HB5"
	PIN 78: "WF0_2G_HB6"

Valid values for function are:
	"eth", "wifi", "i2c", "led", "flash", "pcie", "pwm", "spi",
	"dfd", "uart", "watchdog", "snfi", "ext", "jtag".

Valid values for groups are:
additional data is put followingly with valid value allowing us to know which
applicable function and which relevant pins (in pin#) are able applied for that
group.

	Valid value		function	pins (in pin#)
	-------------------------------------------------------------------------
	"wf0_5g"		"wifi"		0, 1, 2, 3, 4, 5, 6, 7, 8, 9, 10
	"wf0_2g"		"wifi"		70, 71, 72, 73, 74, 75, 76, 77, 78
	"mdc_mdio"		"eth"		49, 50
	"i2c_0"			"i2c"		19, 20
	"i2c_1"			"i2c"		53, 54
	"ephy_leds"		"led"		12, 13, 14, 15, 16, 17, 18
	"ephy_led0"		"led"		12
	"ephy_led1"		"led"		13
	"ephy_led2"		"led"		14
	"ephy_led3"		"led"		15
	"ephy_led4"		"led"		16
	"wf2g_led"		"led"		17
	"wf5g_led"		"led"		18
	"gphy_leds_0"		"led"		21, 22, 23
	"gphy_led1_0"		"led"		21
	"gphy_led2_0"		"led"		22
	"gphy_led3_0"		"led"		23
	"gphy_leds_1"		"led"		57, 58, 59
	"gphy_led1_1"		"led"		57
	"gphy_led2_1"		"led"		58
	"gphy_led3_1"		"led"		59
	"pcie_pereset"		"pcie"		51
	"pcie_wake"		"pcie"		55
	"pcie_clkreq"		"pcie"		56
	"pwm_0"			"pwm"		52
	"pwm_1"			"pwm"		61
	"spi_0"			"spi"		21, 22, 23, 24
	"spi_1"			"spi"		62, 63, 64, 65
	"spi_wp"		"spi"		66
	"spi_hold"		"spi"		67
	"dfd"			"dfd"		12, 13, 14, 15, 16
	"uart1_0_txd_rxd"	"uart"		25, 26
	"uart1_1_txd_rxd"	"uart"		53, 54
	"uart2_0_txd_rxd"	"uart"		29, 30
	"uart2_1_txd_rxd"	"uart"		57, 58
	"uart1_0_cts_rts"	"uart"		27, 28
	"uart1_1_cts_rts"	"uart"		55, 56
	"uart2_0_cts_rts"	"uart"		31, 32
	"uart2_1_cts_rts"	"uart"		59, 60
	"uart0_txd_rxd"		"uart"		68, 69
	"watchdog"		"watchdog"	11
	"snfi"			"spi"		62, 63, 64, 65
	"snfi_wp"		"spi"		66
	"snfi_hold"		"spi"		67
	"conn_ext_pri_0"	"ext"		21
	"conn_ext_pri_1"	"ext"		57
	"conn_ext_act_0"	"ext"		22
	"conn_ext_act_1"	"ext"		58
	"conn_wlan_act_0"	"ext"		23
	"conn_wlan_act_1"	"ext"		59
	"ext2bt_active_0"	"ext"		30
	"ext2bt_active_1"	"ext"		52
	"ext2wf_tx_active_0"	"ext"		31
	"ext2wf_tx_active_1"	"ext"		60
	"ext2ext_tx_active"	"ext"		32
	"wf2ext_tx_active"	"ext"		61
	"jtag" 			"jtag"		12, 13, 14, 15

Example:

	pio: pinctrl@10217000 {
		compatible = "mediatek,leopard-pinctrl";
		reg = <0 0x10217000 0 0x1000>;
		gpio-controller;
		#gpio-cells = <2>;

		pinctrl_eth_default: eth-default {
			mux-mdc_mdio {
				groups = "mdc_mdio";
				function = "eth";
				drive-strength = <12>;
			};

			mux-wf0_5g {
				groups = "wf0_5g";
				function = "wifi";
				drive-strength = <12>;
			};

			mux-wf0_2g {
				groups = "wf0_2g";
				function = "wifi";
				drive-strength = <8>;
			};

			conf-uart {
				pins = "UART0_TXD";
				bias-pull-up;
			};
		};
	};
```

## trunk/linux-4.4.x/Documentation/devicetree/bindings/watchdog/mtk-wdt.txt
```
Mediatek SoCs Watchdog timer

Required properties:

- compatible should contain:
	* "mediatek,mt2701-wdt" for MT2701 compatible watchdog timers
	* "mediatek,mt7623-wdt" for MT7623 compatible watchdog timers
	* "mediatek,mt8521p-wdt" for MT8521p compatible watchdog timers
	* "mediatek,mt6589-wdt" for all compatible watchdog timers (MT2701,
		MT7623, MT6589 and MT8521p)

- reg : Specifies base physical address and size of the registers.

Example:

wdt: watchdog@010000000 {
	compatible = "mediatek,mt6589-wdt";
	reg = <0x10000000 0x18>;
};
```
