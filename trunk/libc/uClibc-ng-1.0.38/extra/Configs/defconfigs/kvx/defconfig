## trunk/linux-4.4.x/drivers/misc/mediatek/conn_md/Kconfig
```kconfig
config MTK_CONN_MD
	bool "Support mtk connsys modem config"
	default y if MTK_CONN_LTE_IDC_SUPPORT
	help
	  CONFIG_MTK_CONN_MD
```

## trunk/linux-4.4.x/drivers/misc/mediatek/emi/Kconfig
```kconfig
config MTK_EMI_BWL
	bool "Enable EMI bandwidth limiter"
	help
	  Say y here to select this option to enable the EMI bandwidth limiter.
	  This driver support to change bandwidth strategy for different scenairo.

config MTK_EMI_7622
	bool "Enable EMI BWL setting for 7622"
	help
	  Say y here to select the EMI bandwidth setting for 7622.
```

## trunk/linux-4.4.x/drivers/misc/mediatek/ext_gic/Kconfig
```kconfig
config MTK_GIC_EXT
	bool "MTK gic extension for FIQ support"
	depends on !MTK_GIC && FIQ && MTK_IN_HOUSE_TEE_SUPPORT
	default y if FIQ=y && MTK_IN_HOUSE_TEE_SUPPORT=y
	help
	  Add extensions for GIC driver.
	  Normally this feature is not configed unless you exactly
	  know how to use this feature.

	  Support for the fiq register and map linux irq to hwirq.
```

## trunk/linux-4.4.x/drivers/misc/mediatek/hw_random/Kconfig
```kconfig
config MTK_HWRNG
	bool "Mediatek Hardware Random Generator"
	default N
	select MTK_IN_HOUSE_TEE_SUPPORT
	select HW_RANDOM
	---help---
		Hardware random generator support for MediaTek SOC
```

## trunk/linux-4.4.x/drivers/misc/mediatek/rt-regmap/Kconfig
```kconfig
config RT_REGMAP
	bool "Richtek regmap"
	default n
	help
	  Say Y to enable Richtek regmap
```
