/*
 * Copyright (c) 2014 MediaTek Inc.
 * Author: Eddie Huang <eddie.huang@mediatek.com>
 *
 * This program is free software; you can redistribute it and/or modify
 * it under the terms of the GNU General Public License version 2 as
 * published by the Free Software Foundation.
 *
 * This program is distributed in the hope that it will be useful,
 * but WITHOUT ANY WARRANTY; without even the implied warranty of
 * MERCHANTABILITY or FITNESS FOR A PARTICULAR PURPOSE.  See the
 * GNU General Public License for more details.
 */

/dts-v1/;
#include "mt8173p1v2_common.dtsi"

/ {
	chosen {
		bootargs = "console=ttyS0,921600n1 root=/dev/ram initrd=0x44000000,0x750000 debugshell=1 \
printk.disable_uart=0 rootwait initcall_debug=1 loglevel=8";
	};
};

