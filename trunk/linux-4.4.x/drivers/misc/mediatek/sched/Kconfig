## trunk/linux-4.4.x/drivers/misc/mediatek/sched/Kconfig
```kconfig
menu "MTK Cluster MultiProcessor Scheduler"
config MTK_CPU_TOPOLOGY
        bool "MTK cpu topology infrastructure"
	depends on (64BIT && OF && SMP) || (ARM_CPU_TOPOLOGY && OF)
	default n
        help
          Say N if you want to build up another wheel
          sched_init -> cmp_cputopo_domain_seutp()
          rest_init -> fork kernel_init -> kernel_init_freeable ... -> parse_dt_topology
          we focus to build up cpu topology and domain before scheduler runs.

endmenu

menu "MTK runqueue statistic calculation"
config MTK_SCHED_RQAVG_KS
	bool "Enable runqueue statistic calculation used in kernel space operation"
	depends on SMP
	help
		MTK ruqueue statistic kernel space CPUfreq governors, e.g., hotplug
		TLP estimation,
		heavy task detection and
		per CPU load for kernel space CPUfreq governors

config MTK_SCHED_RQAVG_US
	bool "Enable runqueue staticsic calculation used in user space operation"
	depends on SMP && HIGH_RES_TIMERS
	help
		TLP estimation for user space CPUfreq governors
endmenu
```

## trunk/linux-4.4.x/drivers/misc/mediatek/secure_efuse/Kconfig
```kconfig
config MTK_SECURE_EFUSE
	bool "Enable MTK secure eFuse support"
	depends on HAVE_MTK_IN_HOUSE_TEE_SUPPORT
	default n
	help
	  This enables MTK secure eFuse to read efuse
	  in secure world
```

## trunk/linux-4.4.x/drivers/misc/mediatek/systimer/Kconfig
```kconfig
config MTK_SYSTIMER
	bool "MTK systimer trigger interrupt support"
	help
	  Say y here to select this option to enable the MTK systimer interrupt.
	  This driver support to trigger interrupt for systimer enabled.
```

## trunk/linux-4.4.x/drivers/misc/mediatek/thermal/Kconfig
```kconfig
config MTK_TURNKEY_THERMAL
	bool "MTK_TURNKEY_THERMAL"
	help
	  This is for MTK thermal driver.
```

## trunk/linux-4.4.x/drivers/misc/mediatek/trustzone/Kconfig
```kconfig
config HAVE_MTK_IN_HOUSE_TEE_SUPPORT
	bool "Enable MTK in-house TEE Solution"
	def_bool n
	help
	  This option decides if the chip can support MTK TEE.
	  Set to yes if MTK TEE is supported.
	  If you don't know if it is supported, setting to no.
	  This option is needed if you would like to turn on MTK TEE.

config MTK_IN_HOUSE_TEE_SUPPORT
	bool "Enable MTK In House TEE Support"
	depends on HAVE_MTK_IN_HOUSE_TEE_SUPPORT
	default n
	help
	  This enable MTK TEE support.

config MTK_IN_HOUSE_TEE_CRYPTO_DRIVER
	bool "Enable MTK In House TEE Crypto Driver"
	depends on MTK_IN_HOUSE_TEE_SUPPORT
	help
	   This enable sha256 and ctr(aes) crypto driver
```

## trunk/linux-4.4.x/drivers/misc/mediatek/usb_c/Kconfig
```kconfig
#
# MediaTek USB USB TYPEC Driver
#

config USB_C_SWITCH
	bool "USB TYPE-C Driver"
	default n
	---help---
	  Enables to support usb-c. So the usb device and host driver register
	  the callback func to the usb-c driver. When the usb-c driver detect
	  a device/host plugged in/out, it will notify the device/host driver
	  by callback func.
	  If unsure, say N.

config USB_C_SWITCH_FUSB302
	bool "MediaTek USB TYPE-C Driver with external solution (FUSB302)"
	default n
	select USB_C_SWITCH
	---help---
	  Enable to support usb-c.
	  usb-c is supported by fusb302 and fusb340 and redriver.
	  Only supports CC detect, without PD.
	  And support DRP, aka UFP and DFP mode.
	  If unsure, say N.

config USB_C_SWITCH_SII70XX
	bool "MediaTek USB TYPE-C Driver with external solution (sii70xx)"
	default n
	select USB_C_SWITCH
	---help---
	  Enable to support usb-c.
	  usb-c is supported by Sii7033 and redriver.
	  Sii7033 supports CC detect, PD and MHL alt mode.
	  And support DRP, aka UFP and DFP mode.
	  If unsure, say N.

config USB_C_SWITCH_SII70XX_MHL_MODE
	bool "MediaTek USB TYPE-C Driver with external solution (sii70xx MHL Mode)"
	default n
	---help---
	  Enable to support usb-c MHL Mode.
	  usb-c is supported by Sii7033 and redriver.
	  Sii7033 MHL Mode supports only MHL alt mode.
	  If unsure, say N.

config USB_C_SWITCH_ANX7418
	bool "Analogix Type-C interface support"
	default n
	select USB_C_SWITCH
	---help---
	  Enable to support usb-c.
	  usb-c is supported by ANX7418.
	  ANX7418 supports CC detect, PD and DP alt mode.
	  And support DRP, aka UFP and DFP mode.
	  If unsure, say N.

config USB_C_SWITCH_MT6336
	bool "MediaTek USB TYPE-C Driver (MT6336)"
	default n
	select USB_C_SWITCH
	---help---
	  Enables MT6336 supporting USB TYPE-C & PD.
	  MT6336 can communicate with the partner
	  and cable by attached CC pin.
	  Also can be SRC/SNK and DFP/UFP. It is
	  a dual role port.
	  If unsure, say N.

config USB_C_SWITCH_MT6392
	bool "MediaTek USB TYPE-C Driver (MT6392)"
	default n
	select USB_C_SWITCH
	---help---
	  Enables MT6392 supporting USB TYPE-C only.
	  MT6392 can communicate with the partner
	  and cable by attached CC pin.
	  Also can be SRC/SNK and DFP/UFP. It is
	  a dual role port.
	  If unsure, say N.

config TCPC_CLASS
	bool "TypeC Port Controller Device Class"
	help
	  Say Y to enable
	  Typec Port
	  Controller Device
	  Class

config USB_POWER_DELIVERY
	bool "Support USB power delivery Function"
	default n
	help
	  Say Y to enable
	  USB
	  Power Delivery
	  support

config TCPC_RT1711
	bool "Richtek RT1711 TypeC port Controller Driver"
	depends on TCPC_CLASS
	default n
	help
	  Say Y to enable
	  Richtek RT1711
	  TypeC port Controller
	  Driver

config TCPC_RT1711H
	bool "Richtek RT1711H TypeC port Controller Driver"
	depends on TCPC_CLASS
	select USB_C_SWITCH
	default n
	help
	  Say Y to enable
	  Richtek RT1711H
	  TypeC port Controller
	  Driver

config USB_PD_VBUS_STABLE_TOUT
	int "PD VBUS Stable Timeout"
	depends on USB_POWER_DELIVERY
	range 0 1000                       # >= 0,  <= 1000
	default 125
	help
	  Setup a timeout value (ms)
	  for
	  VBUS change
	  stable

config RT7207_ADAPTER
	bool "Richtek RT7207 PD Adapter"
	depends on TCPC_CLASS
	default n
	help
	  Say Y to enable
	  Richtek RT7207
	  PD Adapter
	  Function.
```

## trunk/linux-4.4.x/drivers/mmc/host/mt7621-sd/Kconfig
```kconfig
config MMC_MT7621
	tristate "MT7621 SD/MMC"
	depends on !MTD_NAND_RALINK && MMC && SOC_MT7621
	help
	  This selects the MediaTek(R) Secure digital and Multimedia card Interface.
	  If you have a machine with a integrated SD/MMC card reader, say Y or M here.
	  This is needed if support for any SD/SDIO/MMC devices is required.
	  If unsure, say N.
```

## trunk/linux-4.4.x/drivers/net/ethernet/mediatek/Kconfig
```kconfig
config NET_VENDOR_MEDIATEK
	bool "MediaTek ethernet driver"
	depends on ARCH_MEDIATEK || RALINK
	---help---
	  If you have a Mediatek SoC with ethernet, say Y.

if NET_VENDOR_MEDIATEK

config NET_MEDIATEK_SOC
	tristate "MediaTek SoC Gigabit Ethernet support"
	depends on NET_VENDOR_MEDIATEK
	select PHYLIB
	---help---
	  This driver supports the gigabit ethernet MACs in the
	  MediaTek SoC family.

config NET_MEDIATEK_DBG
	bool "Mediatek Ethernet debug interface"
	depends on NET_MEDIATEK_SOC

config NET_MEDIATEK_HNAT
	tristate "MediaTek HW NAT support"
	depends on NET_MEDIATEK_SOC && NF_CONNTRACK && NF_CONNTRACK_IPV4 && IP_NF_NAT
	---help---
	  This driver supports the hardward
	  Network Address Translation in the
	  MediaTek MT2701/MT7622/MT7629/MT7621
	  chipset family

config NET_MEDIATEK_HW_QOS
	bool "Mediatek HW QoS support"
	depends on NET_MEDIATEK_HNAT
	default n
	---help---
	  This driver supports the hardward
	  quality of service (QoS) control
	  for the hardware NAT in the
	  MediaTek chipset family.

config ARCH_MT7622_WIFI_HW_NAT
	bool
	default y if NET_MEDIATEK_HNAT=m && RA_HW_NAT=n && MTK_EMI_7622=y

endif #NET_VENDOR_MEDIATEK
```

## trunk/linux-4.4.x/drivers/net/ethernet/raeth/Kconfig
```kconfig
config RAETH
	tristate "Mediatek Ethernet GMAC"
	---help---
	  This driver supports Mediatek gigabit ethernet family of
	  adapters.

	  Note that the answer to this question doesn't directly affect the
	  kernel: saying N will just cause the configurator to skip all
	  the questions about Mediatek Ethernet devices. If you say Y,
	  you will be asked for your specific card in the following questions.

if RAETH

config  GE1_SGMII_FORCE_2500
	bool "SGMII_FORCE_2500 (GigaSW)"
	depends on RAETH
	---help---
	  If you want to use sgmii force 2500.
	  Please enable GE1_SGMII_FORCE_2500.
          Switch must support SGMII interface.
	  This config will impact switch app makefile.

config ETH_SKB_ALLOC_SELECT
	bool "SKB Allocation API Select"

choice
	prompt "SKB Allocation API Selection"
	depends on ETH_SKB_ALLOC_SELECT
	default ETH_PAGE_ALLOC_SKB

config  ETH_SLAB_ALLOC_SKB
	bool "SLAB skb allocation"

config  ETH_PAGE_ALLOC_SKB
	bool "Page skb allocation"

endchoice

config  RAETH_ESW_CONTROL
	bool "Embedded (or MT7530) Switch Control Module (VLAN/Isolation/Status)"
	default y

config  RAETH_ESW_PORT_WAN
	int "ESW WAN Port ID (0..4)"
	depends on RAETH_ESW_CONTROL
	default 4

config  RAETH_ESW_PORT_LAN1
	int "ESW LAN1 Port ID (0..4)"
	depends on RAETH_ESW_CONTROL
	default 0

config  RAETH_ESW_PORT_LAN2
	int "ESW LAN2 Port ID (0..4)"
	depends on RAETH_ESW_CONTROL
	default 1

config  RAETH_ESW_PORT_LAN3
	int "ESW LAN3 Port ID (0..4)"
	depends on RAETH_ESW_CONTROL
	default 2

config  RAETH_ESW_PORT_LAN4
	int "ESW LAN4 Port ID (0..4)"
	depends on RAETH_ESW_CONTROL
	default 3

endif 	# RAETH
```

## trunk/linux-4.4.x/drivers/net/wireless/mediatek/Kconfig
```kconfig
menuconfig WL_MEDIATEK
	bool "Mediatek Wireless LAN support"
	---help---
	  Enable community drivers for MediaTek WiFi devices.
	  Those drivers make use of the Linux mac80211 stack.


if WL_MEDIATEK
source "drivers/net/wireless/mediatek/mt7601u/Kconfig"

menuconfig WIFI_DRIVER
	bool "WiFi Driver Support"

if WIFI_DRIVER

choice
	prompt "Choose First WiFi Interface"
	config FIRST_IF_NONE
	bool "None"

	config FIRST_IF_MT7615E
	bool "MT7615E"
	select WIFI_MT_MAC
	select MT_MAC

	config FIRST_IF_MT7622
	bool "MT7622"
	select WIFI_MT_MAC
	select MT_MAC

	config FIRST_IF_MT7626
	bool "MT7626"
	select WIFI_MT_MAC
	select MT_MAC

	config FIRST_IF_MT7915
	bool "MT7915"
	select WIFI_MT_MAC
	select MT_MAC

endchoice

choice
	prompt "Choose Second WiFi Interface"
	config SECOND_IF_NONE
	bool "None"

	config SECOND_IF_MT7615E
	bool "MT7615E"
	select WIFI_MT_MAC
	select MULTI_INF_SUPPORT

endchoice

choice
	prompt "Choose Third WiFi Interface"
	config THIRD_IF_NONE
	bool "None"

	config THIRD_IF_MT7615E
	bool "MT7615E"
	select WIFI_MT_MAC
	select MULTI_INF_SUPPORT

endchoice

config RT_FIRST_CARD
	int
	depends on !FIRST_IF_NONE
	default 7615 if FIRST_IF_MT7615E
	default 7622 if FIRST_IF_MT7622
	default 7622 if FIRST_IF_MT7626
	default 7915 if FIRST_IF_MT7915

config RT_SECOND_CARD
	int
	depends on !SECOND_IF_NONE
	default 7615 if SECOND_IF_MT7615E

config RT_THIRD_CARD
	int
	depends on !THIRD_IF_NONE
	default 7615 if THIRD_IF_MT7615E

config RT_FIRST_IF_RF_OFFSET
	hex
	depends on !FIRST_IF_NONE
	default 0x0

config RT_SECOND_IF_RF_OFFSET
	hex
	depends on !SECOND_IF_NONE
	default 0x8000

config RT_THIRD_IF_RF_OFFSET
	hex
	depends on !THIRD_IF_NONE
	default 0x10000

if (FIRST_IF_MT7615E || SECOND_IF_MT7615E || FIRST_IF_MT7915)
menu "MT7615/MT7915 common configs"

choice
	prompt "PA LNA Type of 1st Card"
	depends on ! FIRST_IF_NONE

	config FIRST_IF_EPAELNA
	bool "ePAeLNA"
	config FIRST_IF_IPAILNA
	bool "iPAiLNA"		
	config FIRST_IF_IPAELNA
	bool "iPAeLNA"
endchoice

choice
	prompt "PA LNA Type of 2nd Card"
	depends on ! SECOND_IF_NONE

	config SECOND_IF_EPAELNA
	bool "ePAeLNA"
	config SECOND_IF_IPAILNA
	bool "iPAiLNA"		
	config SECOND_IF_IPAELNA
	bool "iPAeLNA"
endchoice

choice
	prompt "PA LNA Type of 3rd Card"
	depends on ! THIRD_IF_NONE

	config THIRD_IF_EPAELNA
	bool "ePAeLNA"
	config THIRD_IF_IPAILNA
	bool "iPAiLNA"		
	config THIRD_IF_IPAELNA
	bool "iPAeLNA"
endchoice

choice
	prompt "Main Mode"
	default WIFI_MODE_AP

	config WIFI_MODE_AP
	tristate "AP"
	select MT_AP_SUPPORT

	config WIFI_MODE_STA
	tristate "STA"
	select MT_STA_SUPPORT

	config WIFI_MODE_BOTH
	tristate "APSTA"
	select MT_AP_SUPPORT
	select MT_STA_SUPPORT
endchoice
endmenu
endif

if (FIRST_IF_MT7615E || SECOND_IF_MT7615E)
menu "MediaTek MT7615E PCIe Wireless driver"
source "drivers/net/wireless/mediatek/mt7615/embedded/Kconfig"
endmenu
endif

if (FIRST_IF_MT7915)
menu "MediaTek MT7915 PCIe Wireless driver"
source "drivers/net/wireless/mediatek/mt7915/embedded/Kconfig"
endmenu
endif

#source "drivers/net/wireless/mediatek/mt_wifi/embedded/Kconfig"

endif # WIFI_DRIVER
endif # WL_MEDIATEK
```
