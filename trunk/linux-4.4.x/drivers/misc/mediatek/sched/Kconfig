## trunk/linux-4.4.x/drivers/net/wireless/mediatek/mt76x2_ap/Kconfig
```kconfig
config MT76X2_AP
	tristate "MediaTek MT7620/MT7602E/7612E 802.11 AP driver"
	select WIRELESS_EXT
	select WEXT_SPY
	select WEXT_PRIV

config  MT76X2_AP_LED
	bool "LED support"
	depends on MT76X2_AP
	default y

config  MT76X2_AP_LED_SOFT
	bool "Soft LED support"
	depends on MT76X2_AP && !MT76X2_AP_LED && RALINK_GPIO_LED
	default n

config  MT76X2_AP_LED_SOFT_GPIO
	int "Soft LED GPIO pin (dev #0)"
	depends on MT76X2_AP
	depends on MT76X2_AP_LED_SOFT
	default -1

config  MT76X2_AP_LED_SOFT_GPIO_DEV1
	int "Soft LED GPIO pin (dev #1)"
	depends on MT76X2_AP
	depends on MT76X2_AP_LED_SOFT
	depends on (RT_FIRST_IF_MT7602E || RT_FIRST_IF_MT7612E || RT_FIRST_IF_MT7620) && (RT_SECOND_IF_MT7602E || RT_SECOND_IF_MT7612E)
	default -1

config  MT76X2_AP_LLTD
	bool "LLTD (Link Layer Topology Discovery Protocol)"
	depends on MT76X2_AP
	default y

config  MT76X2_AP_WDS
	bool "WDS support"
	depends on MT76X2_AP
	default y

config  MT76X2_AP_MBSS
	bool "MBSSID support"
	depends on MT76X2_AP
	default y

config  MT76X2_AP_MBSS_NEW_MBSSID_MODE
	bool "New MBSSID mode support"
	depends on MT76X2_AP
	depends on MT76X2_AP_MBSS
	default n

config  MT76X2_AP_APCLI
	bool "AP-Client support"
	depends on MT76X2_AP
	default y

config  MT76X2_AP_APCLI_CERT
	bool "AP-Client TGn Cert support"
	depends on MT76X2_AP
	depends on MT76X2_AP_APCLI
	default n

config  MT76X2_AP_APCLI_AUTO_BW
	bool "AP-Client Auto Bandwidth Support"
	depends on MT76X2_AP
	depends on MT76X2_AP_APCLI
	default n

config  MT76X2_AP_MAC_REPEATER
	bool "MAC Repeater Mode support"
	depends on MT76X2_AP
	depends on MT76X2_AP_APCLI
	default n

config  MT76X2_AP_MWDS
	bool "Wireless Mixed Bridge Mode (MWDS)"
	depends on MT76X2_AP
	select MT76X2_AP_APCLI
	default n

config  MT76X2_AP_SMART_MESH
	bool "Smart Mesh"
	depends on MT76X2_AP
	select MT76X2_AP_MWDS
	default n

config  MT76X2_AP_CON_WPS
	bool "Concurrent WPS support"
	depends on MT76X2_AP
	depends on MT76X2_AP_APCLI
	depends on RT_WSC_V2
	default n

config  MT76X2_AP_AIRPLAY
	bool "AirPlay support"
	depends on MT76X2_AP
	default n

config  MT76X2_AP_DFS
	bool "DFS support"
	depends on MT76X2_AP
	default n

config  MT76X2_AP_CARRIER
	bool "Carrier Detection support"
	depends on MT76X2_AP
	default n

config  MT76X2_AP_GREENAP
	bool "Green AP mode support"
	depends on MT76X2_AP
	depends on RT_FIRST_IF_MT7620

config  MT76X2_AP_IDS
	bool "IDS (Intrusion Detection System) support"
	depends on MT76X2_AP
	default n

config  MT76X2_AP_DLS
	bool "802.11e DLS (Direct-Link Setup) support"
	depends on MT76X2_AP
	default n

config  MT76X2_AP_80211AC_VHT
	bool "802.11ac support"
	depends on MT76X2_AP
	depends on (RT_FIRST_IF_MT7612E || RT_SECOND_IF_MT7612E)
	default y

config  MT76X2_AP_TXBF_SUPPORT
	bool "Tx Beam Forming support"
	depends on MT76X2_AP
	depends on (RT_FIRST_IF_MT7612E || RT_SECOND_IF_MT7612E)
	default n

choice
	prompt "MT7620 Power Design"
	depends on MT76X2_AP
	depends on RT_FIRST_IF_MT7620
	default MT76X2_AP_INTERNAL_PA_INTERNAL_LNA
config MT76X2_AP_INTERNAL_PA_INTERNAL_LNA
	bool "Internal PA & Internal LNA"
config MT76X2_AP_INTERNAL_PA_EXTERNAL_LNA
	bool "Internal PA & External LNA"
config MT76X2_AP_EXTERNAL_PA_EXTERNAL_LNA
	bool "External PA & External LNA"
endchoice

config  MT76X2_AP_RTMP_INTERNAL_TX_ALC
	bool "MT7620 TSSI Compensation (Internal TX ALC)"
	depends on MT76X2_AP
	depends on RT_FIRST_IF_MT7620
	depends on !MT76X2_AP_EXTERNAL_PA_EXTERNAL_LNA
	default n

config  MT76X2_AP_RTMP_TEMPERATURE_COMPENSATION
	bool "MT7620 Temperature Compensation (External TX ALC)"
	depends on MT76X2_AP
	depends on RT_FIRST_IF_MT7620
	default n

config  MT76X2_AP_ADJ_PWR_CONSUMPTION
	bool "MT7620 Reduce Power Consumption"
	depends on MT76X2_AP
config RT_SINGLE_SKU
	bool "Single SKU regspec"
	default n

config RT_MAX_CLIENTS
	int "Maximum Wireless clients (16/32/48/64/128). More clients - more MEM and CPU usage"
	default 32

config RT_BAND_STEERING
	bool "Band Steering support"
	depends on !RT_SECOND_IF_NONE
	default n

config RT_DOT11R_FT
	bool "802.11r Fast BSS Transition support"
	default n

config RT_DOT11K_RRM
	bool "802.11k Radio Resource Management support"
	default n

config RT_80211N_DRAFT3
	bool "802.11n Draft3 (BSS Coexistence)"
	default n

config RT_80211W_PMF
	bool "802.11w Protected Management Frames (PMF) support"
	default n

#config RT_WAPI
#	bool "WAPI support"
#	default n

config RT_WSC
	bool "WSC (WiFi Simple Config)"
	default n

config RT_WSC_V2
	bool "WSC V2 (WiFi Simple Config Version 2)"
	depends on RT_WSC
	default n

config RT_WSC_NFC
	bool "WSC out-of-band (NFC)"
	depends on RT_WSC
	default n

config RT_ED_MONITOR
	bool "ED CCA Monitor support"
	default n

config RT_IGMP_SNOOP
	bool "IGMP snooping (M2U in wireless driver)"
	default n

config RT_MCAST_RATE_SPECIFIC
	bool "User specific TX rate of mcast packets"
	default n

config RT_DELAYED_TCP_ACK
	bool "Delayed TCP ACK support"
	default n

#config RT_HDR_TRANS
#	bool "Header Translation RX support"
#	default n

#config RT_CSO
#	bool "Checksum offload (CSO) support"
#	default n

config RT_NETIF_BLOCK
	bool "NETIF Block"
	default n
	help
	  Support Net interface block while Tx-Sw queue full

#config RT_VIDEO_TURBINE
#	bool "Video Turbine support"
#	default n

config RT_SNMP
	bool "Support SNMPD counters"
	default n

config RT_CFG80211
	bool "CFG80211 support (Linux wireless configuration API)"
	depends on CFG80211
	default n

config RT_READ_MAC_FROM_MTD
	bool "Read and set MAC address from MTD/EEPROM"
	default y

config RT_MEMORY_OPTIMIZATION
	bool "Memory optimization (shrink ring size). Need for < 32Mb RAM devices"
	default n

#config RT_BIG_ENDIAN
#	bool "Big-endian platform support"
#	default n

#config RT_MC_SUPPORT
#	bool "Multiple PCIe card support"
#	default n

#config RT_ATE
#	bool "Provide ATE testmode commands support"
#	default n

#config RT_QA
#	bool "Provide QA tool support"
#	depends on RT_ATE
#	default n

config RT_DEBUG
	bool "Include Debug messages"
	default n
	depends on RT_FIRST_IF_MT7620
	default n
```

## trunk/linux-4.4.x/drivers/pinctrl/mediatek/Kconfig
```kconfig
menu "MediaTek pinctrl drivers"
	depends on ARCH_MEDIATEK || COMPILE_TEST

config EINT_MTK
	bool "MediaTek External Interrupt Support"
	depends on PINCTRL_LEOPARD || COMPILE_TEST
	depends on OF
	select IRQ_DOMAIN

config PINCTRL_MTK_COMMON
	bool
	depends on OF
	select PINMUX
	select GENERIC_PINCONF
	select GPIOLIB
	select OF_GPIO

# For ARMv7 SoCs
config PINCTRL_MT2701
	bool "Mediatek MT2701 pin control"
	depends on OF
	default MACH_MT2701 || MACH_MT8521P || MACH_MT7623
	select PINCTRL_MTK_COMMON

config PINCTRL_LEOPARD
	bool "MediaTek LEOPARD pin control"
	depends on MACH_LEOPARD || COMPILE_TEST
	depends on OF
	default MACH_LEOPARD
	select PINMUX
	select GENERIC_PINCONF
	select GENERIC_PINCTRL_GROUPS
	select GENERIC_PINMUX_FUNCTIONS
	select GPIOLIB
	select OF_GPIO
	select EINT_MTK

config PINCTRL_MT8135
	bool "Mediatek MT8135 pin control"
	depends on OF
	default MACH_MT8135
	select PINCTRL_MTK_COMMON

config PINCTRL_MT8127
	bool "Mediatek MT8127 pin control"
	depends on OF
	default MACH_MT8127
	select PINCTRL_MTK_COMMON

# For ARMv8 SoCs
config PINCTRL_MT2712
	bool "Mediatek MT2712 pin control"
	depends on OF
	depends on ARM64 || COMPILE_TEST
	default ARM64 && ARCH_MEDIATEK
	select PINCTRL_MTK_COMMON

config PINCTRL_MT7622
	bool "Mediatek MT7622 pin control"
	depends on OF
	depends on ARM64 || COMPILE_TEST || MACH_MT7622
	default ARM64 && ARCH_MEDIATEK || MACH_MT7622
	select PINCTRL_MTK_COMMON

config PINCTRL_MT8173
	bool "Mediatek MT8173 pin control"
	depends on OF
	depends on ARM64 || COMPILE_TEST
	default ARM64 && ARCH_MEDIATEK
	select PINCTRL_MTK_COMMON

# For PMIC
config PINCTRL_MT6397
	bool "Mediatek MT6397 pin control" if COMPILE_TEST && !MFD_MT6397
	depends on OF
	default MFD_MT6397
	select PINCTRL_MTK_COMMON

endmenu
```
